## config/boards/shields/cool642tb/Kconfig.defconfig
```kconfig
if SHIELD_COOL642TB_R

config ZMK_KEYBOARD_NAME
    default "cool642tb_R"

config ZMK_SPLIT
    default y

config ZMK_SPLIT_ROLE_CENTRAL
    default y

endif

if SHIELD_COOL642TB_L

config ZMK_KEYBOARD_NAME
    default "cool642tb_L"

config ZMK_SPLIT
    default y

endif

if SHIELD_ROBA_R || SHIELD_ROBA_L

config RGBLED_WIDGET_BATTERY_LEVEL_HIGH
    default 30

config RGBLED_WIDGET_BATTERY_LEVEL_CRITICAL
    default 10

endif
```

## config/west.yml
```yaml
manifest:
  remotes:
    - name: zmkfirmware
      url-base: https://github.com/zmkfirmware
    - name: badjeff
      url-base: https://github.com/badjeff
    - name: caksoylar  # <-- RGB LED
      url-base: https://github.com/caksoylar
    - name: prospector
      url-base: https://github.com/t-ogura      
  projects:
    - name: zmk
      remote: zmkfirmware
      revision: main
      import: app/west.yml
    - name: zmk-pmw3610-driver
      remote: badjeff
      revision: main
    - name: zmk-rgbled-widget
      remote: caksoylar
      revision: main
    - name: prospector-zmk-module
      remote: prospector
      revision: v2.2.1
      path: modules/prospector-zmk-module
  self:
    path: config
    
```
